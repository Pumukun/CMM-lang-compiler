str = "Hello World!";
print str;

str2 = "C-- xd";
print str2;
