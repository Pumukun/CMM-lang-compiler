string str
str = "Hello World!"
string str2 = "C-- xd"
print s
