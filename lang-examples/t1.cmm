a = 5\
b =d 8s\
a ddds=| b + 8
print a|
