a =\\ 5;
b =d 8s\;
a dd/ds=| b + 8;
print a|;
