a = 5;
b = 8;
a = 10 + 8 - (2 + 3) + 3;
print a;
