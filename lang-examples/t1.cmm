a = 5;
b = 8;
a = b + 8 - (2 + 3) + 3;
print a;
